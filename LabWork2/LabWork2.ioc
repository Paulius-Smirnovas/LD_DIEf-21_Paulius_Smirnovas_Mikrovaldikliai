# file: LabWork2.ioc
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Mcu.Family=STM32F4
Mcu.Name=STM32F407V(E-G)Tx
Mcu.Package=LQFP100
NVIC.PriorityGroup=NVIC_PRIORITYGROUP_0
ProjectManager.HeapSize=0x200
ProjectManager.StackSize=0x400
ProjectManager.TargetToolchain=STM32CubeIDE
RCC.48MHZClocksFreq_Value=14285714.285714285
RCC.AHBFreq_Value=50000000
RCC.APB1CLKDivider=RCC_HCLK_DIV4
RCC.APB1Freq_Value=12500000
RCC.APB1TimFreq_Value=25000000
RCC.APB2CLKDivider=RCC_HCLK_DIV4
RCC.APB2Freq_Value=12500000
RCC.APB2TimFreq_Value=25000000
RCC.CortexFreq_Value=50000000
RCC.HCLKFreq_Value=50000000
RCC.HSE_VALUE=8000000
RCC.HSI_VALUE=16000000
RCC.LSE_VALUE=32768
RCC.PLLM=8
RCC.PLLN=50
RCC.PLLQ=7
RCC.SYSCLKFreq_VALUE=50000000
RCC.SYSCLKSource=RCC_SYSCLKSOURCE_PLLCLK
RCC.VCOOutputFreq_Value=100000000
board=STM32F407G-DISC1

// file: Core/Src/main.c
/* USER CODE BEGIN Header */
/**
  ******************************************************************************
  * @file           : main.c
  * @brief          : Main program body
  ******************************************************************************
  * @attention
  *
  * Copyright (c) 2024 STMicroelectronics.
  * All rights reserved.
  *
  * This software is licensed under terms that can be found in the LICENSE file
  * in the root directory of this software component.
  * If no LICENSE file comes with this software, it is provided AS-IS.
  *
  ******************************************************************************
  */
/* USER CODE END Header */
#include "main.h"

void SystemClock_Config(void);
/* USER CODE BEGIN PFP */
void SystemClock_Config(void);
void GPIO_Init(void);
/* USER CODE END PFP */

int main(void)
{

  /* MCU Configuration--------------------------------------------------------*/

  /* Reset of all peripherals, Initializes the Flash interface and the Systick. */
  HAL_Init();

  /* Configure the system clock */
  SystemClock_Config();

  /* Initialize all configured peripherals */
  GPIO_Init();
  /* USER CODE BEGIN 2 */

  // Enable clock for GPIOD and GPIOA
  RCC->AHB1ENR |= (RCC_AHB1ENR_GPIODEN | RCC_AHB1ENR_GPIOAEN);

  // Configure PD12, PD13, PD14 and PD15 as output
  GPIOD->MODER |= (GPIO_MODER_MODER12_0 | GPIO_MODER_MODER13_0 | GPIO_MODER_MODER14_0 | GPIO_MODER_MODER15_0);

  // Configure PA0 as input
  GPIOA->MODER &= ~GPIO_MODER_MODER0;

  /* USER CODE END 2 */

  /* Infinite loop */
  /* USER CODE BEGIN WHILE */

  int mode = 3;  // Switch variable
  int counter = 0; // Green LED counter
  int blueLedDelay = 1000; // Initial delay for blue LED in milliseconds
  while (1)
  {
	  if(mode==0)
	  {
	    GPIOD->ODR &= ~(GPIO_ODR_OD12 | GPIO_ODR_OD14);
	    HAL_Delay(1000);

	    /* Binary 2 - Green ON, Red OFF */
	    GPIOD->ODR |= GPIO_ODR_OD12;
	    GPIOD->ODR &= ~GPIO_ODR_OD14;
	    HAL_Delay(1000);

	    /* Binary 3 - Both ON */
	    GPIOD->ODR |= (GPIO_ODR_OD12 | GPIO_ODR_OD14);
	    HAL_Delay(1000);
	  }
	  else if(mode==1)
	  {
	      /* Green LED blink every second */
	      GPIOD->ODR ^= GPIO_ODR_OD12;
	      HAL_Delay(1000);

	      counter++;
	      if(counter == 2)
	      {
	        /* Orange LED blink every two seconds */
	        GPIOD->ODR ^= GPIO_ODR_OD13;
	        counter = 0;
	      }
	  }
	  else if(mode==2)
	  {
	    /* Check if user button is pressed */
	    if((GPIOA->IDR & GPIO_IDR_ID0) != 0)  // Assuming the button is connected to PA0
	    {
	      /* Turn on yellow LED */
	      GPIOD->ODR |= GPIO_ODR_OD13;  // Assuming yellow LED is connected to PD13
	    }
	    else
	    {
	      /* Turn off yellow LED */
	      GPIOD->ODR &= ~GPIO_ODR_OD13;
	    }
	  }
	  else if(mode==3)
	  {
	    /* Check if user button is pressed */
	    if((GPIOA->IDR & GPIO_IDR_ID0) != 0)  // Assuming the button is connected to PA0
	    {
	      /* Increase blue LED blinking frequency by 2 seconds */
	      blueLedDelay += 2000;
	      /* Make sure the button is released before checking again */
	      while((GPIOA->IDR & GPIO_IDR_ID0) != 0) {}
	    }
	    /* Blink blue LED with the current delay */
	    GPIOD->ODR ^= GPIO_ODR_OD15;  // Assuming blue LED is connected to PD15
	    HAL_Delay(blueLedDelay);
	  }
    /* USER CODE END WHILE */

  }
}

void GPIO_Init(void)
{
  /* GPIO Ports Clock Enable */
  RCC->AHB1ENR |= (RCC_AHB1ENR_GPIODEN | RCC_AHB1ENR_GPIOAEN);

  /*Configure GPIO pin Output Level */
  GPIOD->ODR &= ~(GPIO_ODR_OD12 | GPIO_ODR_OD13 | GPIO_ODR_OD14 | GPIO_ODR_OD15);

  /*Configure GPIO pins : PD12 PD14 */
  GPIOD->MODER |= (GPIO_MODER_MODER12_0 | GPIO_MODER_MODER13_0 | GPIO_MODER_MODER14_0 | GPIO_MODER_MODER15_0);
  GPIOD->OSPEEDR &= ~(GPIO_OSPEEDER_OSPEEDR12 | GPIO_OSPEEDER_OSPEEDR13 | GPIO_OSPEEDER_OSPEEDR14 | GPIO_OSPEEDER_OSPEEDR15);
  GPIOD->PUPDR &= ~(GPIO_PUPDR_PUPDR12 | GPIO_PUPDR_PUPDR13 | GPIO_PUPDR_PUPDR14 | GPIO_PUPDR_PUPDR15);
}

void SystemClock_Config(void)
{
  RCC_OscInitTypeDef RCC_OscInitStruct = {0};
  RCC_ClkInitTypeDef RCC_ClkInitStruct = {0};

  /** Configure the main internal regulator output voltage
  */
  __HAL_RCC_PWR_CLK_ENABLE();
  __HAL_PWR_VOLTAGESCALING_CONFIG(PWR_REGULATOR_VOLTAGE_SCALE1);

  /** Initializes the RCC Oscillators according to the specified parameters
  * in the RCC_OscInitTypeDef structure.
  */
  RCC_OscInitStruct.OscillatorType = RCC_OSCILLATORTYPE_HSI;
  RCC_OscInitStruct.HSIState = RCC_HSI_ON;
  RCC_OscInitStruct.HSICalibrationValue = RCC_HSICALIBRATION_DEFAULT;
  RCC_OscInitStruct.PLL.PLLState = RCC_PLL_ON;
  RCC_OscInitStruct.PLL.PLLSource = RCC_PLLSOURCE_HSI;
  RCC_OscInitStruct.PLL.PLLM = 8;
  RCC_OscInitStruct.PLL.PLLN = 50;
  RCC_OscInitStruct.PLL.PLLP = RCC_PLLP_DIV2;
  RCC_OscInitStruct.PLL.PLLQ = 7;
  if (HAL_RCC_OscConfig(&RCC_OscInitStruct) != HAL_OK)
  {
    Error_Handler();
  }

  /** Initializes the CPU, AHB and APB buses clocks
  */
  RCC_ClkInitStruct.ClockType = RCC_CLOCKTYPE_HCLK|RCC_CLOCKTYPE_SYSCLK
                              |RCC_CLOCKTYPE_PCLK1|RCC_CLOCKTYPE_PCLK2;
  RCC_ClkInitStruct.SYSCLKSource = RCC_SYSCLKSOURCE_PLLCLK;
  RCC_ClkInitStruct.AHBCLKDivider = RCC_SYSCLK_DIV1;
  RCC_ClkInitStruct.APB1CLKDivider = RCC_HCLK_DIV4;
  RCC_ClkInitStruct.APB2CLKDivider = RCC_HCLK_DIV4;

  if (HAL_RCC_ClockConfig(&RCC_ClkInitStruct, FLASH_LATENCY_1) != HAL_OK)
  {
    Error_Handler();
  }
}

void Error_Handler(void)
{
  __disable_irq();
  while (1)
  {
  }
}
